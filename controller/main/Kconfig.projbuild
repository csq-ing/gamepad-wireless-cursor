## controller/main/Kconfig.projbuild
```kconfig
menu "Remote Log"
    config REMOTE_LOG_ENABLE
        bool "Print log messages received from the receiver via ESP-NOW"
        default y
        help
            When enabled, the controller prints log lines forwarded by
            the receiver over ESP-NOW to its serial console.
endmenu
```

## controller/sdkconfig.defaults
```kconfig
CONFIG_IDF_TARGET="esp32s3"

# Wi-Fi (needed for ESP-NOW, no AP connection required)
CONFIG_ESP_WIFI_SOFTAP_SUPPORT=n

# ESP-NOW security responder requires protocomm security v1
CONFIG_ESP_PROTOCOMM_SUPPORT_SECURITY_VERSION_1=y

# Print remote log messages from receiver (set to n to disable)
CONFIG_REMOTE_LOG_ENABLE=n

# Match the 16 MB flash fitted on the board so the image header is correct.
CONFIG_ESPTOOLPY_FLASHSIZE_16MB=y
CONFIG_ESPTOOLPY_FLASHSIZE="16MB"
```

## receiver/main/Kconfig.projbuild
```kconfig
menu "Remote Log"
    config REMOTE_LOG_ENABLE
        bool "Forward ESP_LOG output to controller via ESP-NOW"
        default y
        help
            When enabled, all ESP_LOG output is forwarded over ESP-NOW
            to the controller board, which prints it on its serial console.
            Useful when the receiver USB port is occupied by HID.
endmenu

menu "XInput USB Gamepad"

    config XINPUT_DEV_VID
        hex "Development USB VID"
        default 0xCAFE
        help
            Development-validation VID only.
            Do not ship production hardware with this value.

    config XINPUT_DEV_PID
        hex "Development USB PID"
        default 0x4012
        help
            Development-validation PID only.
            Do not ship production hardware with this value.

    config XINPUT_POLL_MS
        int "Input report / endpoint polling period (ms)"
        range 1 100
        default 8
        help
            Interrupt endpoint polling interval. Also used as the
            bInterval value in both IN and OUT endpoint descriptors.

endmenu
```

## receiver/sdkconfig.defaults
```kconfig
CONFIG_IDF_TARGET="esp32s2"

# Enable built-in HID class for the configuration channel
CONFIG_TINYUSB_HID_COUNT=1

# Wi-Fi (needed for ESP-NOW, no AP connection required)
CONFIG_ESP_WIFI_SOFTAP_SUPPORT=n

# ESP-NOW security responder requires protocomm security v1
CONFIG_ESP_PROTOCOMM_SUPPORT_SECURITY_VERSION_1=y

# Forward ESP_LOG to controller via ESP-NOW (set to n to disable)
CONFIG_REMOTE_LOG_ENABLE=n
```
